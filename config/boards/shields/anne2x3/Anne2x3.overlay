/ {
    chosen {
        zmk,kscan = &default_kscan;
    };

    default_kscan: kscan {
        compatible = "zmk,kscan-gpio-direct";
        label = "default_kscan";

        input-gpios = 
            <&pro_micro 1  (GPIO_ACTIVE_LOW | GPIO_PULL_UP)>,  // posición lógica 0
            <&pro_micro 0  (GPIO_ACTIVE_LOW | GPIO_PULL_UP)>,  // posición lógica 1
            <&pro_micro 2  (GPIO_ACTIVE_LOW | GPIO_PULL_UP)>,  // posición lógica 2
            <&pro_micro 3  (GPIO_ACTIVE_LOW | GPIO_PULL_UP)>,  // posición lógica 3
            <&pro_micro 4  (GPIO_ACTIVE_LOW | GPIO_PULL_UP)>,  // posición lógica 4
            <&pro_micro 5  (GPIO_ACTIVE_LOW | GPIO_PULL_UP)>;  // posición lógica 5

    };
};
